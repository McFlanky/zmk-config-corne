## config/west.yml
```yaml
manifest:
  defaults:
    revision: v0.3
  remotes:
    - name: zmkfirmware
      url-base: https://github.com/zmkfirmware
    - name: m165437        # Added remote for nice-view-gem
      url-base: https://github.com/M165437
  projects:
    - name: zmk
      remote: zmkfirmware
      import: app/west.yml
    - name: nice-view-gem   # Added project for nice-view-gem
      remote: m165437
      revision: main
  self:
    path: config
```
